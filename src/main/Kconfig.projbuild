## src/main/Kconfig.projbuild
```kconfig
menu "MicropythonAS Configuration"

    menu "SoftAP Configuration"
        comment "SoftAP Configuration"

        config ESP_WIFI_AP_SSID
            string "WiFi AP SSID"
            default "FalconAS"
            help
                SSID (network name) of the devices Soft-AP.

        config ESP_WIFI_AP_PASSWORD
            string "WiFi AP Password"
            default ""
            help
                WiFi password of the Soft-AP. If empty, AP will be OPEN (password-less).

        config ESP_WIFI_AP_CHANNEL
            int "WiFi AP Channel"
            range 1 14
            default 1
            help
                WiFi channel (network channel) of the Soft-AP.

        config ESP_MAX_STA_CONN_AP
            int "Maximal STA connections"
            default 2
            help
                Max number of STAs allowed to connect to Soft-AP.
    endmenu

    menu "MicroPython Interpreter Configuration"
        comment "MicroPython Interpreter Configuration"

        config MICROPYTHON_HEAP_SIZE
            int "Micropython heap size (bytes)"
            range 1024 65536
            default 8192
            help
                Micropython heap size in bytes, default 8 Kilobytes, min 1KB, max 64KB.
    endmenu

endmenu
```
